## Kconfig
```kconfig
config NAGINATA
    bool "Enable Naginata"
    default y

config ZMK_BEHAVIOR_MOD_UNTIL_LAYER
    bool "Enable mod-until-layer behavior"
    default y

config ZMK_BEHAVIOR_NG_OFF_SHIFT
    bool "Enable Naginata-off shift-hold behavior"
    default y
```

## dts/bindings/behaviors/zmk,behavior-hold-tap-solo.yaml
```yaml
# Copyright (c) 2024 The ZMK Contributors
# SPDX-License-Identifier: MIT

description: Hold-tap that immediately resolves to hold if any other key is already pressed

compatible: "zmk,behavior-hold-tap-solo"

include: two_param.yaml

properties:
  bindings:
    type: phandles
    required: true
  tapping-term-ms:
    type: int
    required: true
```

## dts/bindings/behaviors/zmk,behavior-mod-until-layer.yaml
```yaml
# Copyright (c) 2024 The ZMK Contributors
# SPDX-License-Identifier: MIT

description: Modifier pressed while a target layer is active

compatible: "zmk,behavior-mod-until-layer"

include: two_param.yaml
```

## dts/bindings/behaviors/zmk,behavior-naginata.yaml
```yaml
# Copyright (c) 2020 The ZMK Contributors
# SPDX-License-Identifier: MIT

description: Naginata-shiki behavior

compatible: "zmk,behavior-naginata"

include: one_param.yaml

properties:
  late-shift-window-ms:
    type: int
    default: 80
  dual-space-window-ms:
    type: int
    default: 120
    description: "late combo window for SPACE+ENTER dual-shift enter"
  kuten-confirm-enter:
    type: int
    default: 1
    description: "0=disabled, 1=enter, 2=space"
```

## dts/bindings/behaviors/zmk,behavior-ng-off-shift.yaml
```yaml
# Copyright (c) 2026 The ZMK Contributors
# SPDX-License-Identifier: MIT

description: Naginata off key with shift hold and optional caps word on tap

compatible: "zmk,behavior-ng-off-shift"

include: zero_param.yaml

properties:
  tapping-term-ms:
    type: int
    default: 200
  caps-word-behavior:
    type: phandle
    required: true
```

## dts/bindings/behaviors/zmk,behavior-to-layer-press.yaml
```yaml
# Copyright (c) 2026 The ZMK Contributors
# SPDX-License-Identifier: MIT

description: Switch to a layer and forward current position press/release to the target layer

compatible: "zmk,behavior-to-layer-press"

include: one_param.yaml
```
